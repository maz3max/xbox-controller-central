## lib/Kconfig
```kconfig
# Copyright (c) 2023 Maximilian Deubel
# SPDX-License-Identifier: Apache-2.0

menu "Libraries"

rsource "xbox_controller_ble/Kconfig"

endmenu
```

## lib/xbox_controller_ble/Kconfig
```kconfig
menuconfig XBOX_CONTROLLER_BLE
	bool "XBOX Controller BLE client"
	depends on SETTINGS
	depends on !SETTINGS_NONE
	depends on BT
	depends on BT_CENTRAL
	depends on BT_SMP
	depends on BT_BONDABLE
	depends on BT_SETTINGS
	depends on BT_GATT_CLIENT
	depends on ZBUS
	select BT_GATT_AUTO_UPDATE_MTU

if XBOX_CONTROLLER_BLE

config BT_L2CAP_TX_MTU
	int "Maximum supported L2CAP MTU for L2CAP TX buffers"
	default 512

module = XBOX_CONTROLLER_BLE
module-str = XBOX BLE
source "subsys/logging/Kconfig.template.log_config"

endif
```

## west.yml
```yaml
# Copyright (c) 2023 Maximilian Deubel
# SPDX-License-Identifier: Apache-2.0

manifest:
  self:
    west-commands: scripts/west-commands.yml

  remotes:
    - name: ncs
      url-base: https://github.com/nrfconnect

  projects:
    - name: nrf
      remote: ncs
      repo-path: sdk-nrf
      revision: v2.3.0
      import: true

  self:
    path: application
```
